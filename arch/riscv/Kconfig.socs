## arch/riscv/Kconfig.socs
```kconfig
menu "SoC selection"

config SOC_SIFIVE
       bool "SiFive SoCs"
       select SERIAL_SIFIVE
       select SERIAL_SIFIVE_CONSOLE
       select CLK_SIFIVE
       select CLK_SIFIVE_FU540_PRCI
       select SIFIVE_PLIC
       help
         This enables support for SiFive SoC platform hardware.

config ANDES_QEMU_SUPPORT
	bool "Andes QEMU SUPPORT"
	depends on SOC_SIFIVE
	default n
	help
	  Andes QEMU Support.

endmenu
```

## arch/riscv/configs/pc805_defconfig
```kconfig
CONFIG_DEFAULT_HOSTNAME="pc805"
CONFIG_SYSVIPC=y
CONFIG_NO_HZ_IDLE=y
CONFIG_IKCONFIG=y
CONFIG_BLK_DEV_INITRD=y
# CONFIG_RD_GZIP is not set
# CONFIG_RD_BZIP2 is not set
# CONFIG_RD_LZMA is not set
# CONFIG_RD_XZ is not set
# CONFIG_RD_LZO is not set
# CONFIG_RD_LZ4 is not set
CONFIG_EMBEDDED=y
# CONFIG_VM_EVENT_COUNTERS is not set
CONFIG_SLAB=y
CONFIG_SKIP_BSS_INIT=y
CONFIG_PALLADIUM=y
# CONFIG_PLATFORM_AHBDMA is not set
CONFIG_ARCH_RV32I=y
# CONFIG_DSP is not set
# CONFIG_PMA is not set
CONFIG_HZ_1000=y
CONFIG_CMDLINE="console=hvc0 earlycon=sbi"
# CONFIG_SUSPEND is not set
CONFIG_ARCH_MMAP_RND_BITS=17
CONFIG_MODULES=y
CONFIG_MODULE_UNLOAD=y
# CONFIG_BLK_DEV_BSG is not set
# CONFIG_MQ_IOSCHED_DEADLINE is not set
# CONFIG_MQ_IOSCHED_KYBER is not set
CONFIG_FRONTSWAP=y
CONFIG_CMA=y
CONFIG_NET=y
CONFIG_INET=y
CONFIG_NETLINK_DIAG=y
CONFIG_DEVTMPFS=y
CONFIG_DEVTMPFS_MOUNT=y
# CONFIG_BLK_DEV is not set
CONFIG_NETDEVICES=y
CONFIG_MACB=y
# CONFIG_MACB_USE_HWSTAMP is not set
# CONFIG_INPUT_KEYBOARD is not set
# CONFIG_INPUT_MOUSE is not set
# CONFIG_SERIO is not set
CONFIG_VT_HW_CONSOLE_BINDING=y
# CONFIG_LEGACY_PTYS is not set
# CONFIG_LDISC_AUTOLOAD is not set
CONFIG_SERIAL_8250=y
# CONFIG_SERIAL_8250_DEPRECATED_OPTIONS is not set
CONFIG_SERIAL_8250_CONSOLE=y
CONFIG_SERIAL_8250_NR_UARTS=3
CONFIG_SERIAL_8250_RUNTIME_UARTS=3
CONFIG_SERIAL_8250_DW=y
CONFIG_SERIAL_OF_PLATFORM=y
CONFIG_SERIAL_EARLYCON_RISCV_SBI=y
CONFIG_HVC_RISCV_SBI=y
# CONFIG_HW_RANDOM is not set
CONFIG_I2C=y
# CONFIG_HWMON is not set
# CONFIG_HID is not set
# CONFIG_USB_SUPPORT is not set
CONFIG_SYNC_FILE=y
# CONFIG_VIRTIO_MENU is not set
CONFIG_CLK_SIFIVE=y
CONFIG_CLK_SIFIVE_FU540_PRCI=y
# CONFIG_IOMMU_SUPPORT is not set
CONFIG_SIFIVE_PLIC=y
CONFIG_RAS=y
# CONFIG_MANDATORY_FILE_LOCKING is not set
CONFIG_AUTOFS4_FS=y
CONFIG_PROC_CHILDREN=y
CONFIG_TMPFS=y
# CONFIG_MISC_FILESYSTEMS is not set
CONFIG_NLS=y
CONFIG_CRYPTO=y
CONFIG_CRYPTO_CRC32C=y
CONFIG_CRC16=y
CONFIG_CRC_ITU_T=y
CONFIG_CRC7=y
CONFIG_XZ_DEC=y
CONFIG_PRINTK_TIME=y
CONFIG_DEBUG_INFO=y
CONFIG_DEBUG_INFO_DWARF4=y
CONFIG_GDB_SCRIPTS=y
CONFIG_FRAME_WARN=2048
CONFIG_READABLE_ASM=y
# CONFIG_DEBUG_MISC is not set
CONFIG_STACKTRACE=y
# CONFIG_DEBUG_BUGVERBOSE is not set
# CONFIG_FTRACE is not set
# CONFIG_RUNTIME_TESTING_MENU is not set
```

## arch/riscv/platforms/Kconfig
```kconfig
choice
	prompt "platform type"
	default PLAT_AE350

config PLAT_AE350
	bool "ae350 platform"

endchoice

if PLAT_AE350
source "arch/riscv/platforms/ae350/Kconfig"
endif

source "arch/riscv/platforms/picocom/Kconfig"

menu "Common Platform Options"

config PLATFORM_AHBDMA
	prompt "platform AHB DMA support"
	bool
	default y

config ATCSMU
    bool "ATCSMU Support"
    depends on RISCV && PLAT_AE350
    help
     Say N here if you want to disable SMU support
endmenu
```

## arch/riscv/platforms/ae350/Kconfig
```kconfig
menu "AE3XX Platform Options"

config ATCCPUFREQ
	def_bool y
	depends on CPU_FREQ
config ATCDMAC300
	def_bool y
	select SND_FTSSP010
	select MMC_FTSDC
	depends on PLATFORM_AHBDMA

endmenu
```

## arch/riscv/platforms/picocom/Kconfig
```kconfig
menu "Picocom Customized Options"

config SKIP_BSS_INIT
	bool "skip bss memory init"
	help
      This is for simulation and emulation acceleration.
	  Otherwise, say N.

config PALLADIUM
	bool "for PALLADIUM speedup"
	help
      This is for emulation acceleration. uart baudrate is highest.
	  Otherwise, say N.

config PICOCOM_PC805
	bool "for Picocom PC805"
	help
      This is for Picocom PC805
    
config PC805_ERRATA_I2C_COMP_PARAM_1
	bool "for Picocom PC805 i2c errata"
	depends on PICOCOM_PC805
	default y
	help
	  This is for Picocom PC805 i2c errata. The i2c register IC_COMP_PARAM_1 read back is 0.
	  So the i2c driver will process i2c transfer with fifo depth 1 Byte, and more than 1 Byte
	  transfer failed. Correct it and return real hardware fifo depth 8 Bytes.

endmenu
```
